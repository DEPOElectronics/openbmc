## meta-depo/meta-dacn469535003v2/conf/layer.conf
```bitbake
# We have a conf and classes directory, add to BBPATH
BBPATH .= ":${LAYERDIR}"

# We have recipes-* directories, add to BBFILES
BBFILES += "${LAYERDIR}/recipes-*/*/*.bb \
            ${LAYERDIR}/recipes-*/*/*.bbappend"

BBFILE_COLLECTIONS += "dacn469535003v2-layer"
BBFILE_PATTERN_dacn469535003v2-layer = "^${LAYERDIR}/"
LAYERSERIES_COMPAT_dacn469535003v2-layer = "kirkstone"
```

## meta-depo/meta-dazn/conf/machine/dazn.conf
```bitbake
KMACHINE = "aspeed"
KERNEL_DEVICETREE = "${KMACHINE}-bmc-depo-${MACHINE}.dtb"

UBOOT_MACHINE = "evb-ast2500_defconfig"
UBOOT_DEVICETREE = "ast2500-evb"

require conf/machine/include/ast2500.inc
require conf/machine/include/obmc-bsp-common.inc

FLASH_SIZE = "65536"

SERIAL_CONSOLES = "115200;ttyS4"

PREFERRED_PROVIDER_virtual/bootloader = "u-boot-aspeed-sdk"
PREFERRED_PROVIDER_u-boot = "u-boot-aspeed-sdk"
PREFERRED_PROVIDER_u-boot-fw-utils = "u-boot-fw-utils-aspeed-sdk"
```

## meta-depo/meta-min/conf/machine/min.conf
```bitbake
KMACHINE = "aspeed"
#KERNEL_DEVICETREE = "${KMACHINE}-bmc-depo-${MACHINE}.dtb"
KERNEL_DEVICETREE = "aspeed-bmc-bytedance-g220a.dtb"

UBOOT_MACHINE = "evb-ast2500_defconfig"
UBOOT_DEVICETREE = "ast2500-evb"

require conf/machine/include/ast2500.inc
require conf/machine/include/obmc-bsp-common.inc

FLASH_SIZE = "65536"

SERIAL_CONSOLES = "115200;ttyS1 115200;ttyS4"

#PREFERRED_PROVIDER_virtual/phosphor-led-manager-config-native = "reimu-phosphor-led-manager-config-native"

#UBOOT_MACHINE = "ast_g5_phy_config"


MACHINE_STRING = "REIMU-5564 AST2500"
FRUID_SOURCE = "platform"

VIRTUAL-RUNTIME_obmc-host-state-manager ?= "x86-power-control"
VIRTUAL-RUNTIME_obmc-chassis-state-manager ?= "x86-power-control"

#PREFERRED_PROVIDER_virtual/obmc-chassis-mgmt = "package-reimu-5564-apps"
#PREFERRED_PROVIDER_virtual/obmc-fan-mgmt = "package-reimu-5564-apps"
#PREFERRED_PROVIDER_virtual/obmc-flash-mgmt = "package-reimu-5564-apps"
#PREFERRED_PROVIDER_virtual/obmc-host-ipmi-hw ?= "phosphor-ipmi-kcs"
#PREFERRED_PROVIDER_virtual/obmc-system-mgmt = "package-reimu-5564-apps"

PREFERRED_PROVIDER_virtual/bootloader = "u-boot-aspeed-sdk"
PREFERRED_PROVIDER_u-boot = "u-boot-aspeed-sdk"
PREFERRED_PROVIDER_u-boot-fw-utils = "u-boot-fw-utils-aspeed-sdk"
```

## meta-mcst/conf/layer.conf
```bitbake
# We have a conf and classes directory, add to BBPATH
BBPATH .= ":${LAYERDIR}"

# We have recipes-* directories, add to BBFILES
BBFILES += "${LAYERDIR}/recipes-*/*/*.bb \
            ${LAYERDIR}/recipes-*/*/*.bbappend"

# Currently we have no MCST layer, but if we do, we should uncomment this.
# BBFILE_COLLECTIONS += "mcst-layer"
# BBFILE_PATTERN_mcst-layer = "^${LAYERDIR}/"

LAYERSERIES_COMPAT_mcst-layer = "warrior zeus dunfell"
```

## meta-mcst/meta-common/conf/layer.conf
```bitbake
BBPATH .= ":${LAYERDIR}"
BBFILES += "${LAYERDIR}/recipes-*/*/*.bb \
            ${LAYERDIR}/recipes-*/*/*.bbappend"

SANITY_TESTED_DISTROS:append ?= " \
                                  ubuntu-20.04 \n \
                                "
```

## meta-mcst/meta-common/conf/machine/include/reimu.inc
```bitbake
KMACHINE = "aspeed"
KERNEL_DEVICETREE = "${KMACHINE}-bmc-mcst-${MACHINE}.dtb"

require conf/machine/include/ast2400.inc
require conf/machine/include/obmc-bsp-common.inc
require conf/machine/include/flash.inc
require conf/machine/include/serial.inc
```

## meta-mcst/meta-device-mus-a/conf/layer.conf
```bitbake
# We have a conf and classes directory, add to BBPATH
BBPATH .= ":${LAYERDIR}"

# We have recipes-* directories, add to BBFILES
BBFILES += "${LAYERDIR}/recipes-*/*/*.bb \
            ${LAYERDIR}/recipes-*/*/*.bbappend"

BBFILE_COLLECTIONS += "mus-a-layer"
BBFILE_PATTERN_mus-a-layer = "^${LAYERDIR}/"
LAYERSERIES_COMPAT_mus-a-layer = "warrior zeus dunfell"
```

## meta-mcst/meta-device-mus-a/conf/machine/mus-a.conf
```bitbake
require conf/machine/include/reimu.inc
require conf/machine/include/ast2400.inc
UBOOT_MACHINE_mus-a = "ast_g4_phy_config"
MACHINE_STRING = "REIMU-32 MUS-A"
```

## meta-mcst/meta-device-reimu-264/conf/machine/reimu-264.conf
```bitbake
require conf/machine/include/reimu.inc
require conf/machine/include/ast2400.inc
UBOOT_MACHINE_reimu-264 = "ast_g4_phy_config"
MACHINE_STRING = "REIMU-264 AST2400"
```

## meta-mcst/meta-device-reimu-32/conf/machine/reimu-32.conf
```bitbake
require conf/machine/include/reimu.inc
require conf/machine/include/ast2400.inc
UBOOT_MACHINE_reimu-32 = "ast_g4_phy_config"
MACHINE_STRING = "REIMU-32 AST2400"
```

## meta-mcst/meta-device-reimu-5564/conf/machine/reimu-5564.conf
```bitbake
require conf/machine/include/reimu.inc
UBOOT_MACHINE_reimu-5564 = "ast_g5_phy_config"
MACHINE_STRING = "REIMU-5564 AST2500"
```

## meta-mcst/meta-device-reimu-64/conf/machine/reimu-64.conf
```bitbake
require conf/machine/include/reimu.inc
require conf/machine/include/ast2400.inc
UBOOT_MACHINE_reimu-64 = "ast_g4_phy_config"
MACHINE_STRING = "REIMU-64 AST2400"
```

## meta-mcst/meta-device-reimu-6564m/conf/layer.conf
```bitbake
# We have a conf and classes directory, add to BBPATH
BBPATH .= ":${LAYERDIR}"

# We have recipes-* directories, add to BBFILES
BBFILES += "${LAYERDIR}/recipes-*/*/*.bb \
            ${LAYERDIR}/recipes-*/*/*.bbappend"

BBFILE_COLLECTIONS += "reimu-6564m-layer"
BBFILE_PATTERN_reimu-6564m-layer = "^${LAYERDIR}/"
LAYERSERIES_COMPAT_reimu-6564m-layer = "warrior zeus dunfell gatesgarth"
```

## meta-mcst/meta-device-reimu-6564m/conf/machine/reimu-5564.conf
```bitbake
require conf/machine/include/reimu.inc
require conf/machine/include/ast2600.inc
UBOOT_MACHINE_reimu-6564m = "ast_g6_phy_config"
MACHINE_STRING = "REIMU-6564m (AST2600-MNGR)"
```

## meta-mcst/meta-device-reimu-6564m/conf/machine/reimu-6564m.conf
```bitbake
require conf/machine/include/reimu.inc
require conf/machine/include/ast2600.inc
UBOOT_MACHINE_reimu-6564m = "ast2600_openbmc_config"
UBOOT_DEVICETREE = "ast2600-reimu"
MACHINE_STRING = "REIMU-6564m (AST2600-MNGR)"
```

## meta-mcst/meta-flash32/conf/machine/include/flash.inc
```bitbake
FLASH_SIZE = "32768"
FLASH_UBOOT_OFFSET = "0"
FLASH_KERNEL_OFFSET = "384"
FLASH_ROFS_OFFSET = "5248"
FLASH_RWFS_OFFSET = "28672"

RDEPENDS_${KERNEL_PACKAGE_NAME}-base = ""
```

## meta-mcst/meta-flash64/conf/machine/include/flash.inc
```bitbake
FLASH_SIZE = "65536"

#FLASH_UBOOT_OFFSET:flash-65536 = "0"
#FLASH_KERNEL_OFFSET:flash-65536 = "1024"
#FLASH_ROFS_OFFSET:flash-65536 = "10240"
#FLASH_RWFS_OFFSET:flash-65536 = "49152"
```

## meta-mcst/meta-mus-a/conf/machine/mus-a.conf
```bitbake
KMACHINE = "aspeed"
KERNEL_DEVICETREE = "${KMACHINE}-bmc-opp-${MACHINE}.dtb"

require conf/machine/include/ast2400.inc
require conf/machine/include/obmc-bsp-common.inc

UBOOT_MACHINE_mus-a = "ast_g4_phy_config"

FLASH_SIZE = "32768"

SERIAL_CONSOLES = "115200;ttyS1 115200;ttyS4"
```

## meta-mcst/meta-reimu-32/conf/layer.conf
```bitbake
# We have a conf and classes directory, add to BBPATH
BBPATH .= ":${LAYERDIR}"

# We have recipes-* directories, add to BBFILES
BBFILES += "${LAYERDIR}/recipes-*/*/*.bb \
            ${LAYERDIR}/recipes-*/*/*.bbappend"

BBFILE_COLLECTIONS += "reimu-32-layer"
BBFILE_PATTERN_reimu-32-layer = "^${LAYERDIR}/"
LAYERSERIES_COMPAT_reimu-32-layer = "warrior zeus dunfell"

SANITY_TESTED_DISTROS_append ?= " \
                                  ubuntu-18.04 \n \
                                  ubuntu-18.10 \n \
                                "
```

## meta-mcst/meta-reimu-32/conf/machine/reimu-32.conf
```bitbake
KMACHINE = "aspeed"
KERNEL_DEVICETREE = "${KMACHINE}-bmc-mcst-${MACHINE}.dtb"

require conf/machine/include/ast2400.inc
require conf/machine/include/obmc-bsp-common.inc

UBOOT_MACHINE_reimu-32 = "ast_g4_phy_config"

FLASH_SIZE = "32768"

SERIAL_CONSOLES = "115200;ttyS1 115200;ttyS4"

MACHINE_STRING = "REIMU-32 AST2400"
```

## meta-mcst/meta-reimu-64/conf/machine/reimu-64.conf
```bitbake
KMACHINE = "aspeed"
KERNEL_DEVICETREE = "${KMACHINE}-bmc-opp-${MACHINE}.dtb"

require conf/machine/include/ast2400.inc
require conf/machine/include/obmc-bsp-common.inc

UBOOT_MACHINE_reimu-64 = "ast_g4_phy_config"

FLASH_SIZE = "65536"
FLASH_UBOOT_OFFSET = "0"
FLASH_KERNEL_OFFSET = "2048"
FLASH_ROFS_OFFSET = "8192"
FLASH_RWFS_OFFSET = "49152"

SERIAL_CONSOLES = "115200;ttyS4"
```

## meta-sample/meta-ast2500-min/conf/machine/ast2500-min.conf
```bitbake
KMACHINE = "aspeed"
KERNEL_DEVICETREE = "${KMACHINE}-ast2500-evb.dtb"

UBOOT_MACHINE = "evb-ast2500_defconfig"
UBOOT_DEVICETREE = "ast2500-evb"

require conf/machine/include/ast2500.inc
require conf/machine/include/obmc-bsp-common.inc

SERIAL_CONSOLES = "115200;ttyS4"

MACHINE_STRING = "Minimum sample"
FRUID_SOURCE = "platform"

PREFERRED_PROVIDER_virtual/bootloader = "u-boot-aspeed-sdk"
PREFERRED_PROVIDER_u-boot = "u-boot-aspeed-sdk"
PREFERRED_PROVIDER_u-boot-fw-utils = "u-boot-fw-utils-aspeed-sdk"
```
