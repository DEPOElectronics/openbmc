// SPDX-License-Identifier: GPL-2.0+
// Copyright 2020 MCST
/dts-v1/;

#include "aspeed-bmc-mcst-ast2400.dtsi"
#include "aspeed-bmc-mcst-uart2.dtsi"
#include "aspeed-bmc-mcst-flash64.dtsi"
#include "aspeed-bmc-mcst-gpio.dtsi"

/ {
	model = "REIMU-264";
	compatible = "mcst,reimu-264", "aspeed,ast2400";
};
