// SPDX-License-Identifier: GPL-2.0+
// Copyright 2020 MCST
/dts-v1/;

#include "aspeed-bmc-mcst-reimu.dtsi"

/ {
	model = "REIMU-32";
	compatible = "mcst,reimu-32", "aspeed,ast2400";
	aliases {
		serial1 = &uart2; /* AST - Service connector */
		serial0 = &uart1; /* AST - IOHUB ttyS1 */
	};
	chosen {
		stdout-path = "serial1:115200n8";
		bootargs = "console=ttyS1,115200 earlyprintk";
	};
};
