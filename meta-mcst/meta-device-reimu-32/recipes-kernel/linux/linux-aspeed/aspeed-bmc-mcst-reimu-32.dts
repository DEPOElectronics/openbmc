// SPDX-License-Identifier: GPL-2.0+
// Copyright 2020 MCST
/dts-v1/;

#include "aspeed-bmc-mcst-reimu.dtsi"
#include "aspeed-bmc-mcst-uart2.dtsi"
#include "aspeed-bmc-mcst-flash32.dtsi"
#include "aspeed-bmc-mcst-gpio.dtsi"

/ {
	model = "REIMU-32";
	compatible = "mcst,reimu-32", "aspeed,ast2400";
};
