// SPDX-License-Identifier: GPL-2.0+

/ {
    reserved-memory {
        #address-cells = <1>;
        #size-cells = <1>;
        ranges;
        video_engine_memory: jpegbuffer {
            size = <0x02000000>;
            alignment = <0x01000000>;
            compatible = "shared-dma-pool";
            reusable;
        };
    };

    video: video@1e700000 {
        status = "okay";
        compatible = "aspeed,ast2400-video-engine";
        reg = <0x1e700000 0x1000>;
        clocks = <&syscon ASPEED_CLK_GATE_VCLK>, <&syscon ASPEED_CLK_GATE_ECLK>;
        clock-names = "vclk", "eclk";
        interrupts = <7>;
        memory-region = <&video_engine_memory>;
    };
};
