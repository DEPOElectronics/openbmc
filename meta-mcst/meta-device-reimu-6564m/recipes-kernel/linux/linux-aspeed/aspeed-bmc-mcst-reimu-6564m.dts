// SPDX-License-Identifier: GPL-2.0+
// Copyright 2021 MCST
/dts-v1/;

#include "aspeed-bmc-mcst-ast2600.dtsi"
#include "aspeed-bmc-mcst-mus-2600.dtsi"
#include "aspeed-bmc-mcst-uart5.dtsi"
#include "aspeed-bmc-mcst-flash64.dtsi"
#include "aspeed-bmc-mcst-tinyspi.dtsi"
#include "aspeed-bmc-mcst-additional-flash.dtsi"

/ {
	model = "REIMU-6564M";
	compatible = "mcst,reimu-6564m", "aspeed,ast2600";
};
