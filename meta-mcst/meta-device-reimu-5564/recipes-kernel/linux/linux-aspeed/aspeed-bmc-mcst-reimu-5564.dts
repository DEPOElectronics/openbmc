// SPDX-License-Identifier: GPL-2.0+
// Copyright 2020 MCST
/dts-v1/;

#include "aspeed-bmc-mcst-ast2500.dtsi"
#include "aspeed-bmc-mcst-uart5.dtsi"
#include "aspeed-bmc-mcst-flash64.dtsi"
#include "aspeed-bmc-mcst-gpio.dtsi"

/ {
	model = "REIMU-5564";
	compatible = "mcst,reimu-5564", "aspeed,ast2500";
};
